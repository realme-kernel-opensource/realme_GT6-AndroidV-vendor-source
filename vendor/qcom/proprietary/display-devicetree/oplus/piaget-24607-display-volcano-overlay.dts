/dts-v1/;
/plugin/;
#include <dt-bindings/oplus/hw-id.h>
#include "../display/volcano-sde-display-mtp-overlay.dts"

#include "volcano-display-overlay-common.dtsi"
#include "piaget-24607-display-volcano-overlay.dtsi"

/ {
	model = "Qualcomm Technologies, Inc. Volcano MTP,piaget";

	oplus,project-id = <24607  24697  24698  24623  24724>;
};

/* #ifdef OPLUS_FEATURE_DISPLAY */
&mdss_dsi_phy0 {
	oplus,dsi-pll-ssc-disalbed;
};

/*&mdss_dsi_phy1 {
	oplus,dsi-pll-ssc-disalbed;
};*/

/* OPLUS_FEATURE_DISPLAY */
